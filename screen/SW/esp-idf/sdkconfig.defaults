## screen/SW/esp-idf/sdkconfig.defaults
```kconfig
# QNOB Screen Default Configuration
# Common settings for all targets

# Enable C++ exceptions
CONFIG_COMPILER_CXX_EXCEPTIONS=y

# FreeRTOS settings
CONFIG_FREERTOS_HZ=1000

# Log level
CONFIG_LOG_DEFAULT_LEVEL_INFO=y

# SPI RAM (PSRAM) - if available
CONFIG_SPIRAM_MODE_QUAD=y
CONFIG_SPIRAM_SPEED_80M=y

# Partition table
CONFIG_PARTITION_TABLE_CUSTOM=y
CONFIG_PARTITION_TABLE_CUSTOM_FILENAME="partitions.csv"

# WiFi settings
CONFIG_ESP_WIFI_STATIC_RX_BUFFER_NUM=10
CONFIG_ESP_WIFI_DYNAMIC_RX_BUFFER_NUM=32
CONFIG_ESP_WIFI_DYNAMIC_TX_BUFFER_NUM=32

# LWIP settings
CONFIG_LWIP_MAX_SOCKETS=10
CONFIG_LWIP_SO_REUSE=y
CONFIG_LWIP_SO_RCVBUF=y

# NVS
CONFIG_NVS_ENCRYPTION=n
```

## screen/SW/esp-idf/sdkconfig.defaults.esp32c6
```kconfig
# ESP32-C6 Specific Configuration
# Target: Waveshare ESP32-C6-Touch-AMOLED-1.43 with RM67162

CONFIG_IDF_TARGET="esp32c6"

# CPU frequency
CONFIG_ESP_DEFAULT_CPU_FREQ_MHZ_160=y

# Flash settings
CONFIG_ESPTOOLPY_FLASHSIZE_8MB=y
CONFIG_ESPTOOLPY_FLASHMODE_QIO=y
CONFIG_ESPTOOLPY_FLASHFREQ_80M=y

# WiFi 6 support (ESP32-C6 feature)
CONFIG_SOC_WIFI_HE_SUPPORT=y

# USB Serial/JTAG Console
CONFIG_ESP_CONSOLE_USB_SERIAL_JTAG=y

# Single core - no core pinning
CONFIG_FREERTOS_UNICORE=y
```
